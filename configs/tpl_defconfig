## configs/tpl_defconfig
```kconfig
BR2_arm=y
BR2_cortex_a9=y
BR2_ARM_ENABLE_NEON=y
BR2_ARM_ENABLE_VFP=y
BR2_ROOTFS_USERS_TABLES="system/users_table.txt"
BR2_ROOTFS_OVERLAY="board/zynq/rootfs-overlay"
BR2_ROOTFS_PRE_BUILD_SCRIPT=""
BR2_ROOTFS_POST_BUILD_SCRIPT="board/zynq/post-build.sh"
BR2_TARGET_ROOTFS_EXT2=y
BR2_TARGET_ROOTFS_EXT2_SIZE="100M"
BR2_TARGET_ROOTFS_EXT2_4=y
BR2_PACKAGE_HOST_DOSFSTOOLS=y
BR2_PACKAGE_HOST_GENIMAGE=y
BR2_PACKAGE_HOST_MTOOLS=y
BR2_TARGET_GENERIC_HOSTNAME="tpl_laser"
BR2_TARGET_GENERIC_ISSUE="Welcome to TPL Laser V1"
BR2_TARGET_ENABLE_ROOT_LOGIN=y
BR2_TARGET_GENERIC_PASSWD_METHOD="sha-256"
BR2_TARGET_GENERIC_ROOT_PASSWD="875bank"
BR2_SYSTEM_DEFAULT_PATH="/bin:/sbin:/usr/bin:/usr/sbin:/usr/local/bin"

# OpenSSH:
BR2_PACKAGE_OPENSSH=y
BR2_PACKAGE_OPENSSH_SERVER=y

# Install Bash
BR2_PACKAGE_BUSYBOX_SHOW_OTHERS=y
BR2_SYSTEM_BIN_SH="bash"
BR2_PACKAGE_BASH=y

# Utilities
BR2_PACKAGE_SUDO=y

# TCP and Network Utilities
CONFIG_INET=y
CONFIG_INET_TCP_DIAG=y
CONFIG_NET=y
CONFIG_NETFILTER=y
CONFIG_NETDEVICES=y
BR2_PACKAGE_NETCAT=y
BR2_PACKAGE_IPROUTE2=y
BR2_PACKAGE_TCPDUMP=y
BR2_PACKAGE_IFUPDOWN_SCRIPTS=y
BR2_PACKAGE_TELNET=y

# Python packages
BR2_PACKAGE_PYTHON3=y
BR2_PACKAGE_PYTHON3_PY_PYC=y

# Text editors and viewers
BR2_PACKAGE_NANO=y
BR2_PACKAGE_VIM=y

# Time Zone
BR2_TARGET_TZ_INFO=y
BR2_TARGET_TZ_ZONELIST="default"
BR2_TARGET_LOCALTIME="EST"
```
